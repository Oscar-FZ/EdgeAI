## imagenes/meta-proyecto2/conf/layer.conf
```bitbake
# We have a conf and classes directory, add to BBPATH
BBPATH .= ":${LAYERDIR}"

# We have recipes-* directories, add to BBFILES
BBFILES += "${LAYERDIR}/recipes-*/*/*.bb \
            ${LAYERDIR}/recipes-*/*/*.bbappend"

BBFILE_COLLECTIONS += "meta-proyecto2"
BBFILE_PATTERN_meta-proyecto2 = "^${LAYERDIR}/"
BBFILE_PRIORITY_meta-proyecto2 = "6"

LAYERDEPENDS_meta-proyecto2 = "core"
LAYERSERIES_COMPAT_meta-proyecto2 = "kirkstone"
```
